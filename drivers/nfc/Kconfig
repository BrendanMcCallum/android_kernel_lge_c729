## drivers/nfc/Kconfig
```kconfig
#menu "NFC device support"

config LGE_NXP_NFC
	tristate "NXP PN544 support for Near Field Communication"
	depends on I2C
	default y
	help
	  NXP PN544 chip has a module to support NFC (Near Field
	  Communication). This option enables the driver to support it.

config LGE_SU610_NFC
	tristate "SU610 support for NFC"
	default y

config LGE_NXP_DRIVER_TEST
	tristate "support for LGE Driver Test"
	default y
	
#endmenu
```
